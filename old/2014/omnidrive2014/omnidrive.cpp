/*
    omnidrive - Library for omnidirectional movement.

    Includes linear acceleration profile to prevent motor slippage.
    Created by Brian Chen 05/01/2014
    Last Modified by Brian Chen 12/08/2014 7:21:09 PM

    Alpha 1.0
*/


#include "Arduino.h"
#include "pwmMotor.h"
#include "omnidrive.h"

/* macros for getting the max of three numbers */
#define MAXIMUM(a, b, c) ((a>b)?((a>c)?a:c):((b>c)?b:c))
#define MINIMUM(a, b, c) ((a<b)?((a<c)?a:c):((b<c)?b:c))

int16_t lookup[][3] = {
    { 255,   0,-255}, 
    { 250,   5,-255}, 
    { 245,  10,-255}, 
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    { 255,  -5,-250}
};//lookup array

OMNIDRIVE::OMNIDRIVE(PMOTOR &_motorA, PMOTOR &_motorB, PMOTOR &_motorC, PMOTOR &_motorD){
    motorA = &_motorA;
	motorB = &_motorB;
	motorC = &_motorC;
    motorD = &_motorD;
}

/*
move in a direction with angularVelocity, speed and angle input. An acceleration
profile is build into the function to prevent wheel slipping when rapidly changing
speed as experienced during testing.

The maths in this is simple, but confusing (an oxymoron really).
*/

int16_t OMNIDRIVE::move(int16_t angle, uint8_t speed, int16_t angularVelocity){
    unsigned long now = micros();
    unsigned long dt = 0;   //dt for acceleration profile

    float pA, pB, pC;   //actual motor speeds to be applied
    float target_pA, target_pB, target_pC;  //target motor speeds
    float k;    //scaling constant

    int16_t m = 256;

    if (lCallTime != 0){
        //if it's not the first call, lCallTime would have been initialised and so we
        //can calculate dt.
        dt = now - lCallTime;
    }
    lCallTime = now;    //set last call time to now as we won't use "now" anymore.

    //make sure angularVelocity is not > MAX
    if (angularVelocity > MAX){ angularVelocity = MAX; }
    if (angularVelocity < -MAX){ angularVelocity = -MAX; }

    //make sure speed is not >> MAX
    if (speed > MAX){ speed = MAX; }
    if (speed < -MAX){ speed = -MAX; }

    //get motor speeds from lookup array
    target_pA = float(lookup[angle][0] * speed / MAX);
    target_pB = float(lookup[angle][1] * speed / MAX);
    target_pC = float(lookup[angle][2] * speed / MAX);

    pA = target_pA;
    pB = target_pB;
    pC = target_pC;

    //set last motor powers to current
    lpA = pA;
    lpB = pB;
    lpC = pC;

    lTarget_pA = target_pA;
    lTarget_pB = target_pB;
    lTarget_pC = target_pC;

    /************************************************************************/


    /*************************************************************************
    ***** angularVelocity scaling ********************************************
    *************************************************************************/

    //scale speeds from angular velocity. Angular velocity must not be scalled as it is for PID control
    if (angularVelocity > 0){
        m = MAXIMUM(pA, pB, pC);  //get max of speeds

        if (m + angularVelocity > MAX){
            //scale down accordingly with som basic algebra
            k = (MAX - angularVelocity);
            pA = pA / m * k;
            pB = pB / m * k;
            pC = pC / m * k;
        }
    }
    else if (angularVelocity < 0){
        m = MINIMUM(pA, pB, pC);    //get min of speeds

        if (angularVelocity + m < -MAX){
            //scale down accordingly with some basic algebra
            k = (-MAX - angularVelocity);
            pA = pA * k / m;
            pB = pB * k / m;
            pC = pC * k / m;
        }
    }
    //after scalling, we can add angularVelocity and be sure that it's within the limits
    pA += angularVelocity;
    pB += angularVelocity;
    pC += angularVelocity;

    //make sure speeds will actually move the robot.
    if (pA < MOTOR_MIN_SPEED && pA > 0){ pA = MOTOR_MIN_SPEED; }
    if (pB < MOTOR_MIN_SPEED && pB > 0){ pB = MOTOR_MIN_SPEED; }
    if (pC < MOTOR_MIN_SPEED && pC > 0){ pC = MOTOR_MIN_SPEED; }

    if (pA > -MOTOR_MIN_SPEED && pA < 0){ pA = -MOTOR_MIN_SPEED; }
    if (pB > -MOTOR_MIN_SPEED && pB < 0){ pB = -MOTOR_MIN_SPEED; }
    if (pC > -MOTOR_MIN_SPEED && pC < 0){ pC = -MOTOR_MIN_SPEED; }

    //move motors
    (motorA)->move(pA);
    (motorB)->move(pB);
    (motorC)->move(pC);

    return (int16_t)speed * m / MAX;    //returns scaled speed possibly required for pid speed control
}